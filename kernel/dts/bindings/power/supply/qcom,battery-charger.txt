## kernel/dts/bindings/power/supply/qcom,battery-charger.txt
```
QTI battery charger binding

This binding describes the Qualcomm Technologies, Inc. battery charger device.
QTI battery charger gets and sets power supply properties by communicating with
charger firmware running on the remote subsystem (e.g. DSP) over PMIC Glink.

Refer to Documentation/devicetree/bindings/soc/qcom/qcom,pmic-glink.txt for
information on "qcom,pmic_glink" device which is used in the example below.

- compatible:
	Usage: required
	Value type: <stringlist>
	Definition: must be "qcom,battery-charger"

- qcom,thermal-mitigation:
	Usage: optional
	Value type: <prop-encoded-array>
	Definition: Array of fast charge current limit values for different
		    system thermal mitigation levels. This should be a flat
		    array that denotes the maximum charging current (in uA) for
		    each thermal level. Elements should be defined in such a
		    way that the next element is always less than or equal to
		    the current element (descending order).

- qcom,thermal-mitigation-step:
	Usage: optional
	Value type: <u32>
	Definition: Fast charging current step (in uA) which if specified
		    would be used to calculate different system thermal mitigation
		    levels based on the maximum charging current provided by the
		    charger firmware. This property can be specified only if
		    "qcom,thermal-mitigation" property is not specified.
		    Minimum step value is 500000(500 mA).

- qcom,wireless-fw-name:
	Usage: optional
	Value type: <string>
	Definition: Firmware name that needs to be used for updating wireless
		    charger firmware.

- qcom,shutdown-voltage:
	Usage: optional
	Value type: <u32>
	Definition: Battery voltage (in mV) when shutdown needs to be initiated
		    when battery SOC reaches 0 and device is not charging.

- qcom,display-panels:
	Usage: optional
	Value type: <prop-encoded-array>
	Definition: Array of one or more phandles of the display panel(s) that
			sends the DRM blank/unblank notifications.

- qcom,wireless-charging-not-supported:
	Usage: optional
	Value type: <bool>
	Definition: If this property is specified, registration for
		    wireless power supply will be skipped. It should be defined
		    for boards where wireless charging is not supported.

- qcom,typec-usb-role-switch:
	Usage: optional
	Value type: <phandle>
	Definition: Reference to the USB controller node that registers the
		    role switch for a board with a Type-C connector managed by UCSI.
		    The target must have the "usb-role-switch" property. When set,
		    USB power-supply SCOPE is read from this role provider and the
		    legacy charger-firmware SCOPE/CONNECTOR_TYPE properties are not
		    used for connector handling. Device role maps to DEVICE, host
		    role maps to SYSTEM, and no role maps to UNKNOWN. A missing,
		    unbound, or busy provider returns an error, never a stale value.
		    Omit on boards whose connector is handled by charger extcon.

= EXAMPLE

&soc {
	qcom,pmic_glink {
		...
		qcom,battery_charger {
			compatible = "qcom,battery-charger";
			qcom,thermal-mitigation =
					<3000000 1500000 1000000 500000>;
			qcom,wireless-fw-name = "idt9412.bin";
			qcom,shutdown-voltage = <3100>;
		};
		...
	};
};
```
